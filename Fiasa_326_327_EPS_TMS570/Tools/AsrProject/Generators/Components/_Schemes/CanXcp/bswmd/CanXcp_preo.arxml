AUTOSAR XML (schema 3.0.1)
package /MICROSAR
  module config CanXcp_Pre: definition=CanXcp, implementation-config-variant=VARIANT-PRE-COMPILE
    CanXcpGeneral: CanXcpProdErrorDetect=true
  module config CanXcp_Rec: definition=CanXcp
    CanXcpGeneral: CanXcpVersionInfoApi=false, CanXcpDevErrorDetect=false
