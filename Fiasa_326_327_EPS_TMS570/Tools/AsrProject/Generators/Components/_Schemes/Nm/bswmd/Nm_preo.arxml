AUTOSAR XML (schema 3.0.1)
package /MICROSAR
  module config Nm_Pre: definition=Nm, implementation-config-variant=VARIANT-PRE-COMPILE
    NmGlobalConfig:
      NmUserDataEnabled = false
      NmLimpHomeIndication = false
      NmCoordinatorSyncSupport = false
      NmSupportComM21 = false
      NmNodeDetectionEnabled = false
      NmMacroLayerEnabled = false
      NmDiagGatewayExtEnabled = false
      NmGatewayExtEnabled = false
  module config Nm_Rec: definition=Nm
    NmGlobalConfig:
      NmNodeIdEnabled = true
      NmBusSynchronizationEnabled = false
      NmDevErrorDetect = false
      NmVersionInfoApi = false
      NmRemoteSleepIndEnabled = false
      NmPduRxIndicationEnabled = false
      NmStateChangeIndEnabled = true
      NmCoordinatorSupportEnabled = false
      NmProdErrorDetect = true
      NmComControlEnabled = true
      NmStateChangeIndCallback = BswM_Nm_StateChangeNotification
      NmCallbacksPrototypeHeader = BswM_Nm.h
