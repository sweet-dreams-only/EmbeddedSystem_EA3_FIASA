AUTOSAR XML (schema 3.0.1)
package /MICROSAR
  module config SchM_Rec: definition=SchM, implementation-config-variant=VARIANT-PRE-COMPILE  # Configuration of the SchM (BSW Scheduler) module.
    Fim (SchMModuleConfiguration): SchMModuleLiteral=Fim, SchMModuleInclude=Fim.h, SchMModuleConfigVersion=1.0.0, SchMModuleImplementationRef=FiM_Impl
      SCHM_FIM_INSTANCE_0 (InstanceConfiguration): SchMInstanceLiteral=SCHM_FIM_INSTANCE_0
        FIM_EXCLUSIVE_AREA_0 (ExclusiveAreaConf): SchMExclusiveAreaLiteral=FIM_EXCLUSIVE_AREA_0, SchMExclusiveAreaDescription=
