AUTOSAR XML (schema 3.0.1)
package /MICROSAR
  module config SchM_Rec: definition=SchM, implementation-config-variant=VARIANT-PRE-COMPILE  # Configuration of the SchM (BSW Scheduler) module.
    EcuM (SchMModuleConfiguration): SchMModuleLiteral=EcuM, SchMModuleInclude=EcuM.h, SchMModuleConfigVersion=1.0.0, SchMModuleImplementationRef=EcuM_Impl
      SCHM_ECUM_INSTANCE_0 (InstanceConfiguration): SchMInstanceLiteral=SCHM_ECUM_INSTANCE_0
        ECUM_EXCLUSIVE_AREA_0 (ExclusiveAreaConf): SchMExclusiveAreaLiteral=ECUM_EXCLUSIVE_AREA_0, SchMExclusiveAreaDescription=
        ECUM_EXCLUSIVE_AREA_1 (ExclusiveAreaConf):
          SchMExclusiveAreaLiteral = ECUM_EXCLUSIVE_AREA_1
          SchMExclusiveAreaDescription = It is highly hardware dependend how to disable interrupts before entering sleep mode. Please refere to the Technical Reference of EcuM to check if SchMExclusiveAreaImplementation needs to be set to a different value.
          SchMExclusiveAreaImplementation = NONE
    EcuM_MainFunction (SchMMainFunctionMapping): SchMMainFunctionSymbol=EcuM_MainFunction, SchMModuleRef=EcuM
      SchMBswEvent
        SchMBswDerivedTimingEvent: SchMMainFunctionPeriodParamScale=1.0, SchMMainFunctionPeriodParamRef=/MICROSAR/EcuM/EcuMGeneral/EcuMMainFunctionPeriod
