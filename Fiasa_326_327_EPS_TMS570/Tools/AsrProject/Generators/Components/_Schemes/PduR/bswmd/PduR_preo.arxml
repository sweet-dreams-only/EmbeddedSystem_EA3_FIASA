AUTOSAR XML (schema 3.2.1)
package /MICROSAR
  module config PduR_Pre: definition=PduR, implementation-config-variant=VARIANT-PRE-COMPILE
    PduRGeneral:
      PduRMostIfSupport = false
      PduRJ1939Support = false
      PduRApplIfSupport = false
      PduRFrTp2ProvideRxBufferCalls = false
      PduRApplTpSupport = false
      PduRZeroCostOperation = false
      PduRRouting2CSFSupport = false
      PduRDynamicDlcSupport = true
  module config PduR_Rec: definition=PduR
    PduRGeneral: PduRRoutingPathGroupSupport=true, PduRProdErrorDetect=true, PduRDevErrorDetect=false, PduRVersionInfoApi=false, PduRBalanceRoutingTime=true
