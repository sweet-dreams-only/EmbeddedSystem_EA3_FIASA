AUTOSAR XML (schema 3.2.1)
package /MICROSAR
  module config Com_Pre: definition=Com, implementation-config-variant=VARIANT-PRE-COMPILE
    ComGeneral:
      ComEnableStateOnFlags = false
      ComGwCanMost = false
      ComIsLibrary = false
      ComEnableRx = true
      ComEnableTx = true
      ComTmsSupport = true
      ComGw03ConsistencyCheck = true
      ComMainFunctionTxApi = true
      ComMainFunctionRxApi = true
      ComShowError0005AsWarning = true
      ComEnableLoTxConfirmation = true
      ComGetConfigurationStringPtrApi = false
      ComIPduGroupTransmit = false
      ComSignalConversionInterface = false
      ComEnableIndicationFlags = false
      ComEnableTimeoutFlags = false
      ComTransportProtocolSupport = false
      ComMissingSourceValueHandling = false
      ComTsiTestCode = false
      ComRxSignalWriteAccess = false
      ComOptimizeIdTypes = true
      ComEnableSignalInterface = true
      ComVStdLibMemApi = true
      ComGwStopTxOnRxTimeout = false
      ComGwInvalidateTxOnRxTimeout = false
      ComGwTriggerTxOnInvalidation = false
      ComMultipleIPduGroupRefSupport = true
      ComGetStatusApi = true
      ComQueueFailedTransmitRequests = true
      ComSignalAccessMacroApi = true
      ComGetConfigurationIdApi = false
      ComTxTimeoutForTxModeNoneSupport = false
      ComSignalInvalidationApi = true
      ComTriggerTransmissionByCom = true
      ComEnableReceptionFiltering = true
      ComReceptionDMApi = true
      ComEnableSignalGroupInterface = true
      ComEnableUpdateBitSupport = true
      ComDynamicDlcSupport = false
  module config Com_Rec: definition=Com
    ComGeneral:
      ComUseRte = true
      ComConfigurationUseDet = false
      ComVersionInfoApi = false
      ComConfigurationUseDem = true
      ComConfigurationString = (unset)
      ComTriggerIPDUSendApi = false
  module config Com_Pre_Class1: definition=Com
    ComConfig
      ComSignal: ComIssmSignal=false
  module config Com_Pre_Class2: definition=Com
    ComConfig
      ComIPdu
        ComTxIPdu: ComTxIPduUnusedAreasDefault=0
