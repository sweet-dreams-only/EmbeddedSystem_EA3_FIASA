AUTOSAR XML (schema 3.0.1)
package /MICROSAR
  module config CanSM_Pre: definition=CanSM, implementation-config-variant=VARIANT-PRE-COMPILE
  module config CanSM_Rec: definition=CanSM
  module config CanSM_Rec_Class2: definition=CanSM
    CanStateManagerConfiguration: CanSMDevErrorDetect=false, CanSMVersionInfoApi=false, CanSMProdErrorDetect=true
      CanStateManagerNetworks: CanSMBorTimeL1Ch=1.0, CanSMBorTimeL2Ch=1.0
  module config CanSM_Pre_Class2: definition=CanSM
    CanStateManagerConfiguration
      CanStateManagerNetworks: CanSMDisableRxPduGroup=true, CanSMDisableTxPduGroup=true
  module config CanSM_Pre_Class1: definition=CanSM
    CanStateManagerConfiguration: CanSMBusOffNotification=true, CanSMBswMComModeIndication=true, CanSMDisableDMInSilentCom=false
